## sdkconfig.defaults
```kconfig
CONFIG_IDF_TARGET_ESP32S3=y
CONFIG_ESP32S3_DEFAULT_CPU_FREQ_240=y
CONFIG_ESPTOOLPY_FLASHMODE_DIO=y
CONFIG_ESPTOOLPY_FLASHSIZE_16MB=y
CONFIG_ESP32S3_ENABLE_DEFAULT_CPU_FREQ_240=y
CONFIG_ESP32S3_SPIRAM_SUPPORT=y
CONFIG_SPIRAM_SPEED_80M=y
CONFIG_SPIRAM_TYPE_OCTAL=y
CONFIG_ESP32S3_MEMMAP_TRACEMEM=y
CONFIG_BOOTLOADER_WDT_DISABLE=y
CONFIG_TASK_WDT=0
CONFIG_ESP_SYSTEM_BROWNOUT_DET=0
```
